## drivers/tmc2300/Kconfig
```kconfig
# Copyright (c) 2022, Stefano Cottafavi <stefano.cottafavi@gmail.com>
#
# SPDX-License-Identifier: Apache-2.0

menuconfig TMC2300
	bool "Enable support for the TMC2300 stepper driver"
	default y
	depends on DT_HAS_TRINAMIC_TMC2300_ENABLED
	select HAS_TMCLIB
	select SERIAL if $(dt_compat_on_bus,$(DT_COMPAT_TRINAMIC_TMC2300),uart)
	select TMC_UART if $(dt_compat_on_bus,$(DT_COMPAT_TRINAMIC_TMC2300),uart)
	help
		Enable driver for TMC2300 stepper driver.

if TMC2300

# TODO: add diag pin

endif # TMC2300
```

## dts/bindings/trinamic,tmc2300-uart.yml
```yaml
# Copyright (c) 2022, Stefano Cottafavi <stefano.cottafavi@gmail.com>
#
# SPDX-License-Identifier: Apache-2.0

description: TMC2300 stepper driver (UART)

compatible: "trinamic,tmc2300"

include: ["uart-device.yaml", "trinamic,tmc.yml"]

properties:
  slaveaddr:
    type: int
    description: |
      Address of this TMC instance
    default: 0
```
